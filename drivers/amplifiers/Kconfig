## drivers/amplifiers/Kconfig
```kconfig
# SPDX-License-Identifier: GPL-2.0-only
#
# Audio Amplifiers Configuration
#

menu "Audio Amplifiers"

source "drivers/amplifiers/tas256x/Kconfig"
source "drivers/amplifiers/tas25xx/Kconfig"
source "drivers/amplifiers/cs35l41/Kconfig"
source "drivers/amplifiers/cs35l45/Kconfig"
source "drivers/amplifiers/cs40l25/Kconfig"
source "drivers/amplifiers/cs40l26/Kconfig"
source "drivers/amplifiers/drv2624/Kconfig"
source "drivers/amplifiers/audiometrics/Kconfig"

# WM_ADSP support (used by multiple amplifiers)
config SND_SOC_WM_ADSP
	tristate "Wolfson WM_ADSP support"
	help
	  This driver provides support for Wolfson WM_ADSP (Audio DSP)
	  functionality used by various Cirrus Logic amplifiers.

endmenu
```

## drivers/display/Kconfig
```kconfig
# SPDX-License-Identifier: GPL-2.0-only
#
# Display Drivers Configuration
#

menu "Display Drivers"

source "drivers/display/samsung/Kconfig"
source "drivers/display/common/Kconfig"

endmenu 
```

## drivers/edgetpu/Kconfig
```kconfig
# SPDX-License-Identifier: GPL-2.0

source "drivers/edgetpu/abrolhos/Kconfig"
source "drivers/edgetpu/janeiro/Kconfig"
source "drivers/edgetpu/rio/Kconfig"
```

## drivers/gps/broadcom/Kconfig
```kconfig
menu "Broadcom GPS Drivers"

source "drivers/gps/broadcom/bcm47765/Kconfig"

endmenu
```

## drivers/gpu/exynos/Kconfig
```kconfig
# SPDX-License-Identifier: GPL-2.0

menu "Exynos Graphic Devices"
source "drivers/gpu/exynos/g2d/Kconfig"
endmenu
```

## drivers/performance/Kconfig
```kconfig
# SPDX-License-Identifier: GPL-2.0-only

source "drivers/performance/gs_perf_mon/Kconfig"
source "drivers/performance/lat_governors/Kconfig"
```

## drivers/ufs/Kconfig
```kconfig
# SPDX-License-Identifier: GPL-2.0-only
#
# UFS subsystem configuration
#

menuconfig SCSI_UFSHCD
	tristate "Universal Flash Storage Controller"
	depends on SCSI && SCSI_DMA
	select PM_DEVFREQ
	select DEVFREQ_GOV_SIMPLE_ONDEMAND
	select NLS
	help
	  Enables support for UFS (Universal Flash Storage) host controllers.
	  A UFS host controller is an electronic component that is able to
	  communicate with a UFS card. UFS host controllers occur in
	  smartphones, laptops, digital cameras and also in cars.
	  The kernel module will be called ufshcd.

	  To compile this driver as a module, choose M here and read
	  <file:Documentation/scsi/ufs.rst>.
	  However, do not compile this as a module if your root file system
	  (the one containing the directory /) is located on a UFS device.

config SCSI_UFS_EXYNOS_GS
	tristate "EXYNOS UFS Host Controller Driver for GS SoCs"
	depends on SCSI_UFSHCD && SCSI_UFSHCD_PLATFORM
	help
	  This selects the GS UFS host controller driver which
	  run with GS SoCs.

	  If you have a controller with this interface, say Y or M here.

config SCSI_UFS_CRYPTO_SW_KEYS_MODE
	bool "Enable support for software delivered encryption keys"
	depends on SCSI_UFS_CRYPTO
	help
	  The exynos controller supports both hardware and software encryption
	  key modes. The hardware encryption key mode is the default one. This
	  config enables support for software key mode which must be activated
	  via the use_kdn=0 module parameter passed via command line.

config SCSI_UFS_PIXEL_FIPS140
	tristate "Enable FIPS 140 CMVP Module"
	depends on m && SCSI_UFS_EXYNOS_GS && SCSI_UFS_CRYPTO
	select CRYPTO_FIPS140_MERGE_MOD_SECTIONS
	help
	  Build a module capable of executing FIPS140-3 compliant self tests of
	  the UFS crypto engine. The module is used to execute power on self
	  test for cases where the hardware component does not support
	  the functionality natively.

if SCSI_UFSHCD

source "drivers/ufs/core/Kconfig"

source "drivers/ufs/host/Kconfig"

endif
```
